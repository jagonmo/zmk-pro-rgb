## Kconfig
```kconfig
menuconfig RGB_PRO
    bool "ZMK Pro RGB — per-key reactive RGB system"
    select LED_STRIP
    help
      Per-key reactive RGB system for ZMK keyboards with WS2812 addressable
      LEDs. Replaces the stock RGB underglow with 36 animated effects.
      Requires a board-specific LED mapping header.

if RGB_PRO

# --- Animation ---

config RGB_PRO_TICK_MS
    int "Animation frame interval (ms)"
    default 33
    help
      Time between animation frames. 33ms ≈ 30fps. Lower is smoother but
      uses more CPU and battery.

config RGB_PRO_NUM_KEYS
    int "Total number of per-key LEDs"
    default 0
    help
      Must match the number of keys/LEDs defined in your LED mapping header.
      Set this in your zmk-config's .conf file.

config RGB_PRO_MATRIX_ROWS
    int "Number of rows in the key matrix"
    default 1

config RGB_PRO_MATRIX_COLS
    int "Number of columns in the key matrix"
    default 1

# --- Startup defaults ---

config RGB_PRO_START_ON
    bool "Start with RGB enabled at boot"
    default y

config RGB_PRO_BRT_START
    int "Startup brightness (0-100)"
    default 40
    range 0 100

config RGB_PRO_BRT_STEP
    int "Brightness adjustment step (0-100)"
    default 10
    range 1 100

config RGB_PRO_HUE_STEP
    int "Hue adjustment step (degrees)"
    default 15
    range 1 360

config RGB_PRO_REACTIVE_DECAY
    int "Reactive fade decay per frame (0-255)"
    default 12
    range 1 255
    help
      How fast a reactive key fades after being pressed.
      Higher values = faster fade-out.

# --- Idle ---

config RGB_PRO_AUTO_OFF_IDLE
    bool "Turn off LEDs when keyboard is idle"
    default y

# --- Overlays (drawn on top of the running effect) ---
#
# All key positions below are given in KEYMAP ORDER (position 0 is the first
# key in your keymap), not raw LED chain indices.

config RGB_PRO_CAPS_INDICATOR
    bool "Caps-lock indicator"
    default n
    help
      Blinks a key while caps lock is active. Requires
      CONFIG_ZMK_HID_INDICATORS=y.

if RGB_PRO_CAPS_INDICATOR

config RGB_PRO_CAPS_KEY
    int "Key position of the caps-lock key"
    default 0

config RGB_PRO_CAPS_R
    int "Caps indicator red (0-255)"
    default 0

config RGB_PRO_CAPS_G
    int "Caps indicator green (0-255)"
    default 255

config RGB_PRO_CAPS_B
    int "Caps indicator blue (0-255)"
    default 0

config RGB_PRO_CAPS_BLINK_MS
    int "Caps blink cycle (ms)"
    default 1000

endif # RGB_PRO_CAPS_INDICATOR

config RGB_PRO_STATUS_OVERLAY
    bool "Output / Bluetooth profile status overlay"
    default n
    help
      While the chosen layer is active, shows the selected output
      (blue = BLE, red = USB) and the state of the active BLE profile
      (solid blue = connected, blinking blue = paired but disconnected,
      blinking green = unpaired). Non-active profiles are shown dim,
      because ZMK only exposes the active profile's state publicly.

if RGB_PRO_STATUS_OVERLAY

config RGB_PRO_STATUS_LAYER
    int "Layer that shows the status overlay"
    default 1

config RGB_PRO_STATUS_OUT_KEY
    int "Key position of the output toggle key"
    default 0

config RGB_PRO_STATUS_BT_KEY_BASE
    int "Key position of the first BT profile key"
    default 0
    help
      Profile keys are assumed to be laid out consecutively starting here,
      so profile N is at RGB_PRO_STATUS_BT_KEY_BASE + N.

config RGB_PRO_STATUS_BT_COUNT
    int "Number of BT profile keys"
    default 5

config RGB_PRO_STATUS_BLINK_MS
    int "Status blink cycle (ms)"
    default 600

endif # RGB_PRO_STATUS_OVERLAY

config RGB_PRO_BATTERY_INDICATOR
    bool "Battery level indicator"
    default n
    help
      While the chosen layer is active, shows the battery level as a bar
      that fills across a run of keys and sweeps from red (empty) to
      green (full). Requires CONFIG_ZMK_BATTERY_REPORTING=y.

if RGB_PRO_BATTERY_INDICATOR

config RGB_PRO_BATTERY_LAYER
    int "Layer that shows the battery indicator"
    default 1

config RGB_PRO_BATTERY_KEY_START
    int "Key position of the first bar segment"
    default 0

config RGB_PRO_BATTERY_KEY_COUNT
    int "Number of keys in the battery bar"
    default 4

endif # RGB_PRO_BATTERY_INDICATOR

endif # RGB_PRO

config ZMK_BEHAVIOR_RGB_PRO
    bool
    default y
    depends on DT_HAS_ZMK_BEHAVIOR_RGB_PRO_ENABLED
```

## dts/bindings/behaviors/zmk,behavior-rgb-pro.yaml
```yaml
description: Pro per-key RGB control behavior

compatible: "zmk,behavior-rgb-pro"

include: two_param.yaml
```
